/*
╭──────────────────────────────────────────────────────────╮
│ @Author:  TheDirkKnight     @Contact:  github.com/DiSc21 │
│ @License: MIT             @copyright: 2024 TheDirkKnight │
│ @Data:    2025/02/16                                     │
╰──────────────────────────────────────────────────────────╯
╭──────────────────────────────────────────────────────────╮
│ @brief: LED layer indicators — color changes on hold.    │
│                                                          │
│ @depends:                                                │
│ - shared_defs.dtsi (positions, timing, layer defs)       │
│ - behaviors_hrm.dtsi (CREATE_HT_CORE macro)              │
│                                                          │
│ Layer colors:                                            │
│   0 Default    = white/dim  HSB(0,10,2)                  │
│   1 Numbers    = blue       HSB(210,100,100)             │
│   2 F-Keys     = cyan       HSB(180,100,100)             │
│   3 Symbols    = purple     HSB(270,100,100)             │
│   4 Exotic     = yellow     HSB(60,100,100)              │
│   5 Nav        = green      HSB(120,100,100)             │
│   6 Multigrams = orange     HSB(30,100,100)              │
│   7 BT/LED     = (no change)                             │
╰──────────────────────────────────────────────────────────╯
*/

#include <behaviors.dtsi>
#include <dt-bindings/zmk/keys.h>

#include "shared_defs.dtsi"
#include "behaviors_hrm.dtsi"

/* ─── LED Colors ─── */
#define RGB_DEF RGB_COLOR_HSB(0,10,2)
#define RGB_BLU RGB_COLOR_HSB(210,100,100)
#define RGB_CYN RGB_COLOR_HSB(180,100,100)
#define RGB_PUR RGB_COLOR_HSB(270,100,100)
#define RGB_YEL RGB_COLOR_HSB(60,100,100)
#define RGB_GRE RGB_COLOR_HSB(120,100,100)
#define RGB_ORG RGB_COLOR_HSB(30,100,100)

/* ─── Hold-layer macro: press &mo + set LED, release &mo + reset LED ─── */
#define HOLD_LAYER_WITH_LED_CLR_BASE(name, led_color) \
    htl_ ## name: htl_ ## name { \
        compatible = "zmk,behavior-macro-one-param"; \
        wait-ms = <0>; \
        tap-ms = <0>; \
        #binding-cells = <1>; \
        bindings \
            = <&macro_param_1to1>, <&macro_press &mo MACRO_PLACEHOLDER> \
            , <&macro_tap &rgb_ug led_color> \
            , <&macro_pause_for_release> \
            , <&macro_param_1to1>, <&macro_release &mo MACRO_PLACEHOLDER> \
            , <&macro_tap &rgb_ug RGB_DEF>; \
    };

/* ─── Toggle-layer macro: &to layer + set LED ─── */
#define TOGGLE_LAYER_WITH_LED_CLR_BASE(name, led_color, layer_num) \
    tol_ ## name: tol_ ## name { \
        compatible = "zmk,behavior-macro"; \
        wait-ms = <0>; \
        tap-ms = <0>; \
        #binding-cells = <0>; \
        bindings \
            = <&macro_tap &to layer_num> \
            , <&macro_tap &rgb_ug led_color>; \
    };

/* ─── Hold-tap with LED: left-hand (triggers on right) + right-hand (triggers on left) ─── */
#define CREATE_HLT_LED_LR(name, hold_macro, tap_bind, lt_flavor, lt_tapping_term, lt_quick_tap_ms, lt_prior_idle_ms) \
    /omit-if-no-ref/ l_ ## name: l_ ## name { \
        CREATE_HT_CORE(lt_flavor, lt_tapping_term, lt_quick_tap_ms, lt_prior_idle_ms) \
        bindings = <hold_macro>, <tap_bind>; \
        hold-trigger-key-positions = <KEYS_R KEYS_THUMBS>; \
        hold-trigger-on-release; \
    }; \
    /omit-if-no-ref/ r_ ## name: r_ ## name { \
        CREATE_HT_CORE(lt_flavor, lt_tapping_term, lt_quick_tap_ms, lt_prior_idle_ms) \
        bindings = <hold_macro>, <tap_bind>; \
        hold-trigger-key-positions = <KEYS_L KEYS_THUMBS>; \
        hold-trigger-on-release; \
    };

/* ─── Hold-tap with LED: both-side trigger (for multigrams — affects both sides) ─── */
#define CREATE_HLT_LED_BOTH(name, hold_macro, tap_bind, lt_flavor, lt_tapping_term, lt_quick_tap_ms, lt_prior_idle_ms) \
    /omit-if-no-ref/ b_ ## name: b_ ## name { \
        CREATE_HT_CORE(lt_flavor, lt_tapping_term, lt_quick_tap_ms, lt_prior_idle_ms) \
        bindings = <hold_macro>, <tap_bind>; \
        hold-trigger-key-positions = <KEYS_L KEYS_R KEYS_THUMBS>; \
        hold-trigger-on-release; \
    };

/* ─── Combined macro: create hold-layer LED macro + hold-tap behaviors ─── */
#define LT_LED_MACRO(clr_name, layer_num, led_color, lt_flavor, lt_tapping_term, lt_quick_tap_ms, lt_prior_idle_ms) \
    / { \
        macros { \
            HOLD_LAYER_WITH_LED_CLR_BASE(clr_name, led_color) \
            TOGGLE_LAYER_WITH_LED_CLR_BASE(clr_name, led_color, layer_num) \
        }; \
        behaviors { \
            CREATE_HLT_LED_LR(ht_ ## clr_name, &htl_ ## clr_name, &kp, lt_flavor, lt_tapping_term, lt_quick_tap_ms, lt_prior_idle_ms) \
        }; \
    };

/* ─── Both-side variant (for multigrams) ─── */
#define LT_LED_MACRO_BOTH(clr_name, layer_num, led_color, lt_flavor, lt_tapping_term, lt_quick_tap_ms, lt_prior_idle_ms) \
    / { \
        macros { \
            HOLD_LAYER_WITH_LED_CLR_BASE(clr_name, led_color) \
            TOGGLE_LAYER_WITH_LED_CLR_BASE(clr_name, led_color, layer_num) \
        }; \
        behaviors { \
            CREATE_HLT_LED_BOTH(ht_ ## clr_name, &htl_ ## clr_name, &kp, lt_flavor, lt_tapping_term, lt_quick_tap_ms, lt_prior_idle_ms) \
        }; \
    };

/* ═══════════════════════════════════════════════
 * Layer LED instantiations
 *
 * Thumb usage:
 *   LH0: &l_ht_nav  L_NAV    BSPC   (left hold → right affected)
 *   LH1: &l_ht_sym  L_SYM    RET    (left hold → right affected)
 *   LH2: &l_ht_num  L_NUM    TAB    (left hold → right affected)
 *   RH0: &b_ht_mg   L_MG     ESC    (both sides affected)
 *   RH1: &r_ht_fk   L_FKEYS  SPACE  (right hold → left affected)
 *   RH2: &r_ht_exo  L_EXOTIC DEL    (right hold → left affected)
 * ═══════════════════════════════════════════════ */

LT_LED_MACRO(def, L_DEF,    RGB_DEF, "balanced", HM_TAPPING_TERM, LAYER_QUICK_TAP_MS, HM_PRIOR_IDLE)
LT_LED_MACRO(num, L_NUM,    RGB_BLU, "balanced", HM_TAPPING_TERM, LAYER_QUICK_TAP_MS, HM_PRIOR_IDLE)
LT_LED_MACRO(fk,  L_FKEYS,  RGB_CYN, "balanced", HM_TAPPING_TERM, LAYER_QUICK_TAP_MS, HM_PRIOR_IDLE)
LT_LED_MACRO(sym, L_SYM,    RGB_PUR, "balanced", HM_TAPPING_TERM, LAYER_QUICK_TAP_MS, HM_PRIOR_IDLE)
LT_LED_MACRO(exo, L_EXOTIC, RGB_YEL, "balanced", HM_TAPPING_TERM, LAYER_QUICK_TAP_MS, HM_PRIOR_IDLE)
LT_LED_MACRO(nav, L_NAV,    RGB_GRE, "balanced", HM_TAPPING_TERM, LAYER_QUICK_TAP_MS, HM_PRIOR_IDLE)

LT_LED_MACRO_BOTH(mg, L_MG, RGB_ORG, "balanced", HM_TAPPING_TERM, LAYER_QUICK_TAP_MS, HM_PRIOR_IDLE)
