/*
╭──────────────────────────────────────────────────────────╮
│ @Author:  TheDirkKnight     @Contact:  github.com/DiSc21 │
│ @License: MIT             @copyright: 2024 TheDirkKnight │
│ @Data:    2025/02/16                                     │
╰──────────────────────────────────────────────────────────╯
╭──────────────────────────────────────────────────────────╮
│ @brief: Multigram behaviors for layer 6.                 │
│                                                          │
│ @depends:                                                │
│ - shared_defs.dtsi (positions, timing)                   │
│ - behaviors_hrm.dtsi (HRM creation macros)               │
│                                                          │
│ @details:                                                │
│ Each multigram key is a 3-level mod-morph tree:          │
│   SFT → CTL → GUI (innermost)                           │
│                                                          │
│ Modifier effects (independent, composable):              │
│   MGSHIFT = capitalize first letter                      │
│   MGCTRL  = append "."                                   │
│   MGGUI   = append " " (space)                           │
│   MGCTRL+MGGUI = append ". " + sticky shift              │
│                                                          │
│ All modifiers are CONSUMED — released inside macros,     │
│ never passed to OS.                                      │
│                                                          │
│ MG-HRM positions (matching real HRM finger positions):   │
│   Left:  A=MGSHIFT  S=MGCTRL  D=MGGUI                   │
│   Right: K=MGGUI    L=MGCTRL  ;=MGSHIFT                 │
╰──────────────────────────────────────────────────────────╯
*/

#include <behaviors.dtsi>
#include <dt-bindings/zmk/keys.h>

#include "shared_defs.dtsi"
#include "behaviors_hrm.dtsi"

/* ─── Release all MG modifiers before typing ─── */
#define MG_REL \
    &macro_release &kp LSHIFT &kp RSHIFT &kp LCTRL &kp RCTRL &kp LGUI &kp RGUI

/* ─── Leaf macro: types sequence with mods released ─── */
#define MG_MACRO(name, ...) \
    /omit-if-no-ref/ name: name { \
        compatible = "zmk,behavior-macro"; \
        #binding-cells = <0>; \
        wait-ms = <0>; \
        tap-ms = <5>; \
        bindings = <MG_REL>, <&macro_tap __VA_ARGS__>; \
    };

/* ─── Leaf macro: types sequence + sticky shift (for Ctrl+GUI combos) ─── */
#define MG_MACRO_SK(name, ...) \
    /omit-if-no-ref/ name: name { \
        compatible = "zmk,behavior-macro"; \
        #binding-cells = <0>; \
        wait-ms = <0>; \
        tap-ms = <5>; \
        bindings = <MG_REL>, <&macro_tap __VA_ARGS__>, <&sk LSHIFT>; \
    };

/* ─── Mod-morph helpers ─── */
#define MG_MM_SFT(name, base, shifted) \
    /omit-if-no-ref/ name: name { \
        compatible = "zmk,behavior-mod-morph"; \
        #binding-cells = <0>; \
        bindings = <base>, <shifted>; \
        mods = <(MOD_LSFT|MOD_RSFT)>; \
    };

#define MG_MM_CTL(name, base, ctrl) \
    /omit-if-no-ref/ name: name { \
        compatible = "zmk,behavior-mod-morph"; \
        #binding-cells = <0>; \
        bindings = <base>, <ctrl>; \
        mods = <(MOD_LCTL|MOD_RCTL)>; \
    };

#define MG_MM_GUI(name, base, gui) \
    /omit-if-no-ref/ name: name { \
        compatible = "zmk,behavior-mod-morph"; \
        #binding-cells = <0>; \
        bindings = <base>, <gui>; \
        mods = <(MOD_LGUI|MOD_RGUI)>; \
    };

/* ─────────────────────────────────────────────────────────
 * MG_KEY — generates full mod-morph tree for one multigram
 *
 * @param n    : unique name (e.g. tion, and, qu)
 * @param base : base key sequence  (&kp T &kp I &kp O &kp N)
 * @param cap  : capitalized sequence (&kp LS(T) &kp I &kp O &kp N)
 *
 * Generates 15 behaviors per multigram:
 *   8 leaf macros  (p/s/c/g/sc/sg/cg/scg)
 *   4 GUI mod-morphs (innermost)
 *   2 CTL mod-morphs (middle)
 *   1 SFT mod-morph  (root = mg_<n>)
 *
 *   Usage in keymap: &mg_<n>
 * ───────────────────────────────────────────────────────── */
#define MG_KEY(n, base, cap) \
    / { behaviors { \
        /* leaf macros */ \
        MG_MACRO(mg_##n##_p,     base) \
        MG_MACRO(mg_##n##_s,     cap) \
        MG_MACRO(mg_##n##_c,     base &kp DOT) \
        MG_MACRO(mg_##n##_g,     base &kp SPACE) \
        MG_MACRO(mg_##n##_sc,    cap &kp DOT) \
        MG_MACRO(mg_##n##_sg,    cap &kp SPACE) \
        MG_MACRO_SK(mg_##n##_cg,  base &kp DOT &kp SPACE) \
        MG_MACRO_SK(mg_##n##_scg, cap &kp DOT &kp SPACE) \
        /* GUI mod-morphs (innermost) */ \
        MG_MM_GUI(mg_##n##_g0, &mg_##n##_p,  &mg_##n##_g) \
        MG_MM_GUI(mg_##n##_g1, &mg_##n##_c,  &mg_##n##_cg) \
        MG_MM_GUI(mg_##n##_g2, &mg_##n##_s,  &mg_##n##_sg) \
        MG_MM_GUI(mg_##n##_g3, &mg_##n##_sc, &mg_##n##_scg) \
        /* CTL mod-morphs (middle) */ \
        MG_MM_CTL(mg_##n##_c0, &mg_##n##_g0, &mg_##n##_g1) \
        MG_MM_CTL(mg_##n##_c1, &mg_##n##_g2, &mg_##n##_g3) \
        /* SFT mod-morph (root — use this in keymap) */ \
        MG_MM_SFT(mg_##n,     &mg_##n##_c0, &mg_##n##_c1) \
    }; };


/* ─────────────────────────────────────────────────────────
 * MG-HRM — hold-tap for multigram layer homerow positions
 *
 * tap  = multigram root behavior (0-cell)
 * hold = modifier keycode (1-cell &kp)
 *
 * #binding-cells = <2>  →  usage: &mghr_l_xx LSHIFT 0
 *                        (second param is dummy, ignored by 0-cell tap)
 * ───────────────────────────────────────────────────────── */
#define CREATE_MGHR_LEFT(name, tap_bind) \
    /omit-if-no-ref/ mghr_l_ ## name: mghr_l_ ## name { \
        compatible = "zmk,behavior-hold-tap"; \
        #binding-cells = <2>; \
        flavor = "balanced"; \
        tapping-term-ms = <HM_TAPPING_TERM>; \
        quick-tap-ms = <LAYER_QUICK_TAP_MS>; \
        require-prior-idle-ms = <HM_PRIOR_IDLE>; \
        bindings = <&kp>, <tap_bind>; \
        hold-trigger-key-positions = <KEYS_R KEYS_THUMBS>; \
        hold-trigger-on-release; \
    };

#define CREATE_MGHR_RIGHT(name, tap_bind) \
    /omit-if-no-ref/ mghr_r_ ## name: mghr_r_ ## name { \
        compatible = "zmk,behavior-hold-tap"; \
        #binding-cells = <2>; \
        flavor = "balanced"; \
        tapping-term-ms = <HM_TAPPING_TERM>; \
        quick-tap-ms = <LAYER_QUICK_TAP_MS>; \
        require-prior-idle-ms = <HM_PRIOR_IDLE>; \
        bindings = <&kp>, <tap_bind>; \
        hold-trigger-key-positions = <KEYS_L KEYS_THUMBS>; \
        hold-trigger-on-release; \
    };


/* ╔═══════════════════════════════════════════════════════╗
 * ║              MULTIGRAM DEFINITIONS                    ║
 * ╠═══════════════════════════════════════════════════════╣
 * ║                                                       ║
 * ║  LEFT HAND                   RIGHT HAND               ║
 * ║  ╭─────┬─────┬─────┬─────┬─────╮ ╭─────┬─────┬─────┬─────┬─────╮ ║
 * ║  │ qu  │ wh  │ er  │ re  │ th  │ │ you │uous │ ish │ough │ ph  │ ║
 * ║  ├─────┼─────┼─────┼─────┼─────┤ ├─────┼─────┼─────┼─────┼─────┤ ║
 * ║  │ and │ st  │ ing │ for │ ion │ │ ght │ che │ ful │ ly  │ness │ ║
 * ║  │ SFT │ CTL │ GUI │  —  │  —  │ │  —  │  —  │ GUI │ CTL │ SFT │ ║
 * ║  ├─────┼─────┼─────┼─────┼─────┤ ├─────┼─────┼─────┼─────┼─────┤ ║
 * ║  │ at  │ sh  │ ch  │ ed  │ ble │ │ not │ment │true │false│tion │ ║
 * ║  ╰─────┴─────┴─────┴─────┴─────╯ ╰─────┴─────┴─────┴─────┴─────╯ ║
 * ╚═══════════════════════════════════════════════════════╝
 */

/* ─── Left Top Row ─── */
MG_KEY(qu,   &kp Q &kp U,                         &kp LS(Q) &kp U)
MG_KEY(wh,   &kp W &kp H,                         &kp LS(W) &kp H)
MG_KEY(er,   &kp E &kp R,                         &kp LS(E) &kp R)
MG_KEY(re,   &kp R &kp E,                         &kp LS(R) &kp E)
MG_KEY(th,   &kp T &kp H,                         &kp LS(T) &kp H)

/* ─── Left Mid Row (and/st/ing have MG-HRMs, for/ion plain) ─── */
MG_KEY(and,  &kp A &kp N &kp D,                   &kp LS(A) &kp N &kp D)
MG_KEY(st,   &kp S &kp T,                         &kp LS(S) &kp T)
MG_KEY(ing,  &kp I &kp N &kp G,                   &kp LS(I) &kp N &kp G)
MG_KEY(for,  &kp F &kp O &kp R,                   &kp LS(F) &kp O &kp R)
MG_KEY(ion,  &kp I &kp O &kp N,                   &kp LS(I) &kp O &kp N)

/* ─── Left Bottom Row ─── */
MG_KEY(at,   &kp A &kp T,                         &kp LS(A) &kp T)
MG_KEY(sh,   &kp S &kp H,                         &kp LS(S) &kp H)
MG_KEY(ch,   &kp C &kp H,                         &kp LS(C) &kp H)
MG_KEY(ed,   &kp E &kp D,                         &kp LS(E) &kp D)
MG_KEY(ble,  &kp B &kp L &kp E,                   &kp LS(B) &kp L &kp E)

/* ─── Right Top Row ─── */
MG_KEY(you,  &kp Y &kp O &kp U,                   &kp LS(Y) &kp O &kp U)
MG_KEY(uous, &kp U &kp O &kp U &kp S,             &kp LS(U) &kp O &kp U &kp S)
MG_KEY(ish,  &kp I &kp S &kp H,                   &kp LS(I) &kp S &kp H)
MG_KEY(ough, &kp O &kp U &kp G &kp H,             &kp LS(O) &kp U &kp G &kp H)
MG_KEY(ph,   &kp P &kp H,                         &kp LS(P) &kp H)

/* ─── Right Mid Row (ful/ly/ness have MG-HRMs, ght/che plain) ─── */
MG_KEY(ght,  &kp G &kp H &kp T,                   &kp LS(G) &kp H &kp T)
MG_KEY(che,  &kp C &kp H &kp E,                   &kp LS(C) &kp H &kp E)
MG_KEY(ful,  &kp F &kp U &kp L,                   &kp LS(F) &kp U &kp L)
MG_KEY(ly,   &kp L &kp Y,                         &kp LS(L) &kp Y)
MG_KEY(ness, &kp N &kp E &kp S &kp S,             &kp LS(N) &kp E &kp S &kp S)

/* ─── Right Bottom Row ─── */
MG_KEY(not,  &kp N &kp O &kp T,                   &kp LS(N) &kp O &kp T)
MG_KEY(ment, &kp M &kp E &kp N &kp T,             &kp LS(M) &kp E &kp N &kp T)
MG_KEY(tru,  &kp T &kp R &kp U &kp E,             &kp LS(T) &kp R &kp U &kp E)
MG_KEY(fls,  &kp F &kp A &kp L &kp S &kp E,       &kp LS(F) &kp A &kp L &kp S &kp E)
MG_KEY(tion, &kp T &kp I &kp O &kp N,             &kp LS(T) &kp I &kp O &kp N)


/* ─── MG-HRM hold-taps (layer 6 homerow positions) ─── */
/ {
    behaviors {
        /* Left: A=MGSHIFT, S=MGCTRL, D=MGGUI */
        CREATE_MGHR_LEFT(and,  &mg_and)
        CREATE_MGHR_LEFT(st,   &mg_st)
        CREATE_MGHR_LEFT(ing,  &mg_ing)

        /* Right: K=MGGUI, L=MGCTRL, ;=MGSHIFT */
        CREATE_MGHR_RIGHT(ful,  &mg_ful)
        CREATE_MGHR_RIGHT(ly,   &mg_ly)
        CREATE_MGHR_RIGHT(ness, &mg_ness)
    };
};
