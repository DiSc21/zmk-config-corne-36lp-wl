/*
╭──────────────────────────────────────────────────────────╮
│ @Author:  TheDirkKnight     @Contact:  github.com/DiSc21 │
│ @License: MIT             @copyright: 2024 TheDirkKnight │
│ @Data:    2025/01/04                                     │
╰──────────────────────────────────────────────────────────╯
  ⠀⠀⠀⠀⠀⠀⠀⠀⠀⠀⠀⠀⠀⠀⠀⠀⠀⠀⠀⠀⠀⠀⠀⢀⡆⠀⠀⠀⠀⠀⠀⠀⣆
 ⠀⠀⠀⠀⠀⠀⠀⠀⠀⠀⠀⠀⠀⠀⠀⠀⠀⠀⠀⠀⠀⠀⠀⠀⣾⡇⠀⠀⠀⠀⠀⠀⠀⣿⡇
 ⠀⠀⠀⠀⠀⠀⠀⠀⠀⠀⠀⠀⠀⠀⠀⠀⠀⠀⠀⠀⠀⠀⠀⠀⣿⡇⠀⠀⠀⠀⠀⠀⠀⡿⣿
 ⠀⠀⠀⠀⠀⠀⠀⠀⠀⠀⠀⠀⠀⠀⠀⠀⠀⠀⠀⠀⠀⠀⠀⢸⣿⣿⠀⠀⠀⠀⠀⠀⠀⠃⣿⡄
 ⠀⠀⠀⠀⠀⠀⠀⠀⠀⠀⠀⠀⠀⠀⠀⠀⠀⠀⠀⠀⠀⠀⠀⢸⣿⣿⣿⣿⣿⣿⣿⣿⣷⣼⣿⡇
 ⠀⠀⠀⠀⠀⠀⠀⠀⠀⠀⠀⠀⠀⠀⠀⠀⠀⠀⠀⠀⠀⠀⠀⢸⡇⣿⣿⣿⣿⣿⣿⣿⣿⣿⣿
 ⠀⠀⠀⠀⠀⠀⠀⠀⠀⠀⠀⠀⠀⠀⠀⠀⠀⠀⠀⠀⠀⠀⠀⠀⣠⣼⣿⣿⣿⣿⣿⣿⣿⣿⡏
 ⠀⠀⠀⠀⠀⠀⠀⠀⠀⠀⠀⠀⠀⠀⠀⠀⠀⠀⠀⠀⠀⠀⠀⠀⢙⡻⢿⣿⡿⡟⣿⡿⠟⣛⠁
 ⠀⠀⠀⠀⠀⠀⠀⠀⠀⠀⠀⠀⠀⠀⠀⠀⣀⣠⣴⡾⠛⠉⠀⠀⠀⠉⠓⠂ ⡀⠀⠐⠛⠁⠀⠀⠀⣸⣿⣦⣄⡀
 ⠀⠀⠀⠀⠀⠀⠀⠀⠀⢀⣀⣀⣤⣤⣶⣿⣿⣿⣿⣿⣷⣆⠀⠀⠀⠀⠀⠀⢠⡇⠀⠀⠀⠀⠀⠀⠀⠈⣻⣿⣿⣿⣷⣶⣤⣤⣤⣄⣀
 ⠀⠀⠀⠀⠀⠀⢀⣴⣾⣿⣿⣿⣿⣿⣿⣿⣿⣿⣿⣿⣿⡿⠁⠀⠀⠀⠀ ⣀⣀  ⠀⠀⠀⠀⠀⠀⠀⠙⢿⣿⣿⣿⣿⣿⣿⣿⣿⣿⣶⡄
 ⠀⠀⠀⠀⠀⡾⣿⣿⣿⣿⠿⠋⢁⣿⣿⣿⣿⣿⣿⣟⣥⣶⢿⡛⠉⠀⠀⠈⠀⠀⠁⠀⠀⠀⠈⢙⡻⢷⣿⣿⣿⣿⣿⣿⣿⡟⠿⠿⣿⣿⣿⣿
 ⠀⠀⠀⠀⠀⠀⣿⣿⠟⠁⠀⢠⣿⣿⣿⣿⣿⣿⡿⢟⣭⣶⣿⣷⣄⠀⠀⠀⣄⣀⡄⠀⠀⢀⣴⣿⣿⣷⣝⡻⣿⣿⣿⣿⣿⣿⣦⡀⠀⠉⠛⢿
 ⠀⠀⠀⠀⠀⠀⠿⠁⠀⠀⠀⠋⠁⣿⣿⣿⡿⢋⣴⣿⣿⣿⣿⣿⣿⣿⣶⣾⣿⣿⣿⣶⣿⣿⣿⣿⣿⣿⣿⣿⣮⡻⣿⣿⣿⠯⠉⠙
 ⠀⠀⠀⠀⠀⠀⠀⠀⠀⠀⠀⠀⠘⠁⠽⠋⠠⠿⠿⢿⣿⣿⣿⣿⣿⣿⣿⣿⣿⣿⣿⣿⣿⣿⣿⣿⣿⣿⣿⡿⠿⠷⠌⠻⠟
 ⠀⠀⠀⠀⠀⠀⠀⠀⠀⠀⠀⠀⠀⠀⠀⠀⠀⠀⠀⠀⠀⠈⠻⠿⠿⠿⣿⣿⣿⣿⣿⣿⡿⠿⠿⠿⠟⠁
 ⠀⠀⠀⠀⠀⠀⠀⠀⠀⠀⠀⠀⠀⠀⠀⠀⠀⠀⠀⠀⠀⠀⠀⠀⠀⠀⠀⠈⠻⠋
╭──────────────────────────────────────────────────────────╮
│ @brief: ZMK devicetree file.                             │
│                                                          │
│ @depends: shared_defs.dtsi for key positions.            │
╰──────────────────────────────────────────────────────────╯
*/

#include <behaviors.dtsi>
#include <dt-bindings/zmk/keys.h>

#include "shared_defs.dtsi"

#define KEY_SEQ_MACRO_WAIT_MS 40
#define KEY_SEQ_MACRO_TAP_MS 30

///
/// @brief helper for creation of simple macro
///
/// @param tap_bind: behavior sequence processed on tap
///
#define SEQUENCE_SIMPLE(name, tap_bind) \
        /omit-if-no-ref/ name: name { \
            compatible = "zmk,behavior-macro"; \
            wait-ms = <KEY_SEQ_MACRO_WAIT_MS>; \
            tap-ms = <KEY_SEQ_MACRO_TAP_MS>; \
            #binding-cells = <0>; \
            bindings = <&macro_tap tap_bind>; \
        };

///
/// @brief create single-arg &kp-style with some pre and post command
///
/// @param name: name of the created mod-morph
/// @param pre_bind: unmodified binding
/// @param post_bind: the modified behavior
///
#define SINGLE_PARAM_SANDWICH(name, pre_bind, post_bind) \
        /omit-if-no-ref/ name: name { \
            compatible = "zmk,behavior-macro-one-param"; \
            wait-ms = <KEY_SEQ_MACRO_WAIT_MS>; \
            tap-ms = <KEY_SEQ_MACRO_TAP_MS>; \
            #binding-cells = <1>; \
            bindings = <&macro_tap pre_bind> \
                     , <&macro_param_1to1>, <&macro_tap &kp MACRO_PLACEHOLDER> \
                     , <&macro_tap post_bind> \
                     ; \
        };

///
/// @brief create no-arg triple-behavior sequence
///
/// @param name: name of the created mod-morph
/// @param pre_bind: initial binding, e.g. sticky-shift or leading SPACE
/// @param tap_bind: base behavior sandwiched by param pre_bind and post_bind
/// @param pre_bind: end binding, e.g. sticky-shift, leading SPACE or both
///
#define NO_PARAM_SANDWICH(name, pre_bind, tap_bind, post_bind) \
        /omit-if-no-ref/ name: name { \
            compatible = "zmk,behavior-macro"; \
            wait-ms = <KEY_SEQ_MACRO_WAIT_MS>; \
            tap-ms = <KEY_SEQ_MACRO_TAP_MS>; \
            #binding-cells = <0>; \
            bindings = <&macro_tap pre_bind> \
                     , <&macro_tap tap_bind> \
                     , <&macro_tap post_bind> \
                     ; \
        };

///
/// @brief auxiliary macro for the creation of nested mod-morphes
///
/// @param name: name of the created mod-morph
/// @param raw_binding: unmodified binding
/// @param mod_binding: the modified behavior
///
/// @note this is just the main body used in the following explicit mod macros
///
#define CREATE_MOD_MORPH_BASE(name, raw_bind, mod_bind) \
    /omit-if-no-ref/ name: name { \
            compatible = "zmk,behavior-mod-morph"; \
            #binding-cells = <0>; \
            bindings = <raw_bind>, <mod_bind>; \

///
/// @brief macro for the creation of CTRL mod-morphes
///
/// @param name: name of the created mod-morph
/// @param raw_binding: unmodified binding
/// @param mod_binding: the modified behavior
///
#define CREATE_MOD_MORPH_CTL(name, raw_bind, mod_bind) \
    CREATE_MOD_MORPH_BASE(name, raw_bind, mod_bind) \
        mods = <(MOD_LCTL|MOD_RCTL)>; \
    };
/// @brief macro for the creation of ALT mod-morphes
#define CREATE_MOD_MORPH_ALT(name, raw_bind, mod_bind) \
    CREATE_MOD_MORPH_BASE(name, raw_bind, mod_bind) \
        mods = <(MOD_LALT|MOD_RALT)>; \
    };
/// @brief macro for the creation of SHIFT mod-morphes
#define CREATE_MOD_MORPH_SFT(name, raw_bind, mod_bind) \
    CREATE_MOD_MORPH_BASE(name, raw_bind, mod_bind) \
        mods = <(MOD_LSFT|MOD_RSFT)>; \
    };
/// @brief macro for the creation of GUI mod-morphes
#define CREATE_MOD_MORPH_GUI(name, raw_bind, mod_bind) \
    CREATE_MOD_MORPH_BASE(name, raw_bind, mod_bind) \
        mods = <(MOD_LGUI|MOD_RGUI)>; \
    };






///
/// @brief 
///
/// @param 
/// @param 
/// @param 
/// @param 
///
#define SHIFT_CAPS_MACRO(name, first_key, post_bind) \
        /omit-if-no-ref/ mg_shft_ ## name: mg_shft_ ## name { \
            compatible = "zmk,behavior-macro"; \
            wait-ms = <KEY_SEQ_MACRO_WAIT_MS>; \
            tap-ms = <KEY_SEQ_MACRO_TAP_MS>; \
            #binding-cells = <0>; \
            bindings = <&macro_tap &kp LS(first_key) post_bind>; \
        }; \
        /omit-if-no-ref/ mg_raw_ ## name: mg_raw_ ## name { \
            compatible = "zmk,behavior-macro"; \
            wait-ms = <KEY_SEQ_MACRO_WAIT_MS>; \
            tap-ms = <KEY_SEQ_MACRO_TAP_MS>; \
            #binding-cells = <0>; \
            bindings = <&macro_tap &kp first_key post_bind>; \
        };

///
/// @brief macro for the creation of CTRL mod-morphes
///
/// @param name: name of the created mod-morph
/// @param raw_binding: unmodified binding
/// @param mod_binding: the modified behavior
///
#define CREATE_SHIFT_MOD_MACRO(name, first_key, post_bind) \
    SHIFT_CAPS_MACRO(name, first_key, post_bind) \
    CREATE_MOD_MORPH_SFT(mms_ ## name, &mg_raw_ ## name, &mg_shft_ ## name) \

///
/// @brief macro for the creation of CTRL mod-morphes
///
/// @param name: name of the created mod-morph
/// @param raw_binding: unmodified binding
/// @param mod_binding: the modified behavior
///
#define CREATE_DOUBLE_TABDANCE(name, single_bind, double_bind) \
    /omit-if-no-ref/ td_ ## name: td_ ## name { \
        compatible = "zmk,behavior-tap-dance"; \
        #binding-cells = <0>; \
        tapping-term-ms = <TAPDANCE_MS>; \
        bindings = <single_bind>, <double_bind>; \
    };

