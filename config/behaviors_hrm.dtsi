/*
╭──────────────────────────────────────────────────────────╮
│ @Author:  TheDirkKnight     @Contact:  github.com/DiSc21 │
│ @License: MIT             @copyright: 2024 TheDirkKnight │
│ @Data:    2025/01/04                                     │
╰──────────────────────────────────────────────────────────╯
 ⠀⠀⠀⠀⠀⠀⠀⠀⠀⠀⠀⠀⠀⠀⠀⠀⠀⠀⠀⠀⢀⡆⠀⠀⠀⠀⠀⠀⠀⣆              ⠀⠀⠀⣶⡀
⠀⠀⠀⠀⠀⠀⠀⠀⠀⠀⠀⠀⠀⠀⠀⠀⠀⠀⠀⠀⠀⣾⡇⠀⠀⠀⠀⠀⠀⠀⣿⡇               ⣼⣿⣧
⠀⠀⠀⠀⠀⠀⠀⠀⠀⠀⠀⠀⠀⠀⠀⠀⠀⠀⠀⠀⠀⣿⡇⠀⠀⠀⠀⠀⠀⠀⡿⣿             ⠀⣰⣿⣿⣿⣆
⠀⠀⠀⠀⠀⠀⠀⠀⠀⠀⠀⠀⠀⠀⠀⠀⠀⠀⠀⠀⢸⣿⣿⠀⠀⠀⠀⠀⠀⠀⠃⣿⡄           ⠀⢠⣿⣿⣿⣿⣿⣆
⠀⠀⠀⠀⠀⠀⠀⠀⠀⠀⠀⠀⠀⠀⠀⠀⠀⠀⠀⠀⢸⣿⣿⣿⣿⣿⣿⣿⣿⣷⣼⣿⡇           ⣰⣿⣿⣿⣿⣿⣿⣿⣆
⠀⠀⠀⠀⠀⠀⠀⠀⠀⠀⠀⠀⠀⠀⠀⠀⠀⠀⠀⠀⢸⡇⣿⣿⣿⣿⣿⣿⣿⣿⣿⣿           ⣰⣿⣿⣿⠋⠉⠙⣿⣿⣿⣆
⠀⠀⠀⠀⠀⠀⠀⠀⠀⠀⠀⠀⠀⠀⠀⠀⠀⠀⠀⠀⠀⣠⣼⣿⣿⣿⣿⣿⣿⣿⣿⡏          ⣰⣿⣿⣿⡇⠀⠀⠀⢸⣿⣿⣟⣆
⠀⠀⠀⠀⠀⠀⠀⠀⠀⠀⠀⠀⠀⠀⠀⠀⠀⠀⠀⠀⠀⢙⡻⢿⣿⡿⡟⣿⡿⠟⣛⠁        ⠀⣴⣿⠿⠛⠋⠁⠀⠀⠀⠈⠙⠛⠿⣿⣦
⠀⠀⠀⠀⠀⠀⠀⠀⠀⠀⠀⠀⠀⣀⣠⣴⡾⠛⠉⠀⠀⠀⠉⠓⠂ ⡀⠀⠐⠛⠁⠀⠀⠀⣸⣿⣦⣄⡀⠀⠈⠉⠀⠀⠀⠀⠀⠀⠀⠀⠀⠀⠀⠀⠀⠉⠁
⠀⠀⠀⠀⠀⠀⢀⣀⣀⣤⣤⣶⣿⣿⣿⣿⣿⣷⣆⠀⠀⠀⠀⠀⠀⢠⡇⠀⠀⠀⠀⠀⠀⠀⠈⣻⣿⣿⣿⣷⣶⣤⣤⣤⣄⣀
⠀⠀⠀⢀⣴⣾⣿⣿⣿⣿⣿⣿⣿⣿⣿⣿⣿⣿⡿⠁⠀⠀⠀⠀ ⣀⣀  ⠀⠀⠀⠀⠀⠀⠀⠙⢿⣿⣿⣿⣿⣿⣿⣿⣿⣿⣶⡄
⠀⠀⡾⣿⣿⣿⣿⠿⠋⢁⣿⣿⣿⣿⣿⣿⣟⣥⣶⢿⡛⠉⠀⠀⠈⠀⠀⠁⠀⠀⠀⠈⢙⡻⢷⣿⣿⣿⣿⣿⣿⣿⡟⠿⠿⣿⣿⣿⣿
⠀⠀⠀⣿⣿⠟⠁⠀⢠⣿⣿⣿⣿⣿⣿⡿⢟⣭⣶⣿⣷⣄⠀⠀⠀⣄⣀⡄⠀⠀⢀⣴⣿⣿⣷⣝⡻⣿⣿⣿⣿⣿⣿⣦⡀⠀⠉⠛⢿
⠀⠀⠀⠿⠁⠀⠀⠀⠋⠁⣿⣿⣿⡿⢋⣴⣿⣿⣿⣿⣿⣿⣿⣶⣾⣿⣿⣿⣶⣿⣿⣿⣿⣿⣿⣿⣿⣮⡻⣿⣿⣿⠯⠉⠙
⠀⠀⠀⠀⠀⠀⠀⠀⠀⠘⠁⠽⠋⠠⠿⠿⢿⣿⣿⣿⣿⣿⣿⣿⣿⣿⣿⣿⣿⣿⣿⣿⣿⣿⣿⣿⡿⠿⠷⠌⠻⠟
⠀⠀⠀⠀⠀⠀⠀⠀⠀⠀⠀⠀⠀⠀⠀⠀⠀⠀⠈⠻⠿⠿⠿⣿⣿⣿⣿⣿⣿⡿⠿⠿⠿⠟⠁
⠀⠀⠀⠀⠀⠀⠀⠀⠀⠀⠀⠀⠀⠀⠀⠀⠀⠀⠀⠀⠀⠀⠀⠀⠈⠻⠋
╭───────────────────────────────────────────────────────╮
│ @brief: ZMK devicetree file for custom homerow mods.  │
│                                                       │
│ @depends: shared_defs.dtsi for key positions.         │
│                                                       │
│ @details:                                             │
│ Positional Homerow mods                               │
│ Homerow mods that prevent accidental activations when │
│ rolling keys, such as when typing `st` or `ne` on     │
│ colemak-dh layouts or `as` on qwerty.                 │
│                                                       │
│ Only allowing mods to activate within tapping-term if │
│ it's on the opposite side of the keyboard or on the   │
│ same keys.                                            │
╰───────────────────────────────────────────────────────╯
╭─────────────────────────────────────────────────────────╮
│ Using urob's timeless homerow mods method:              │
│ https://github.com/urob/zmk-config#timeless-homerow-mods│
╰─────────────────────────────────────────────────────────╯
*/

#include <behaviors.dtsi>
#include <dt-bindings/zmk/keys.h>

#include "shared_defs.dtsi"

///
/// @brief auxiliary macro for the creational aux macro used for the creation of homerow mods
///
/// @param hold_bind: behavior on hold
/// @param tap_bind: behavior on tap
/// @param ht_flavor: hold-tap basic behavior
/// @param ht_tapping_term: the time a key is tapped
/// @param Ht_quick_tap_ms: quick tap threshold
/// @param ht_prior_idle_ms: expected pre-idel-time
///
/// @note this is just an auxiliray macro for the creational macros for left and right hmrs
///
#define CREATE_HT_CORE(hold_bind, tap_bind, ht_flavor, ht_tapping_term, ht_quick_tap_ms, ht_prior_idle_ms) \
    compatible = "zmk,behavior-hold-tap"; \
    #binding-cells = <2>; \
    bindings = <hold_bind>, <tap_bind>; \
    flavor = ht_flavor; \
    tapping-term-ms = <ht_tapping_term>; \
    quick-tap-ms = <ht_quick_tap_ms>; \
    require-prior-idle-ms = <ht_prior_idle_ms>;

///
/// @brief auxiliary macros for the creation of right-hand homerow mods
///
/// @param tap_bind: behavior on tap
/// @param hold_bind: behavior on hold
/// @param ht_flavor: hold-tap basic behavior
/// @param ht_tapping_term: the time a key is tapped
/// @param ht_quick_tap_ms: quick tap threshold
/// @param ht_prior_idle_ms: expected pre-idel-time
///
#define CREATE_HT_RIGHT(name, hold_bind, tap_bind, ht_flavor, ht_tapping_term, ht_quick_tap_ms, ht_prior_idle_ms) \
    /omit-if-no-ref/ ht_r_ ## name: ht_r_ ## name { \
        CREATE_HT_CORE(tap_bind, hold_bind, ht_flavor, ht_tapping_term, ht_quick_tap_ms, ht_prior_idle_ms) \
        hold-trigger-key-positions = <KEYS_L KEYS_THUMBS>; \
        hold-trigger-on-release; \
    };


#define CREATE_HT_RIGHT_NO_TOR(name, hold_bind, tap_bind, ht_flavor, ht_tapping_term, ht_quick_tap_ms, ht_prior_idle_ms) \
    /omit-if-no-ref/ ht_r_ ## name: ht_r_ ## name { \
        CREATE_HT_CORE(tap_bind, hold_bind, ht_flavor, ht_tapping_term, ht_quick_tap_ms, ht_prior_idle_ms) \
        hold-trigger-key-positions = <KEYS_L KEYS_THUMBS>; \
    };


///
/// @brief auxiliary macro for the creation of left-hand homerow mods
///
/// @param tap_bind: behavior on tap
/// @param hold_bind: behavior on hold
/// @param ht_flavor: hold-tap basic behavior
/// @param ht_tapping_term: the time a key is tapped
/// @param ht_quick_tap_ms: quick tap threshold
/// @param ht_prior_idle_ms: expected pre-idel-time
///
#define CREATE_HT_LEFT(name, hold_bind, tap_bind, ht_flavor, ht_tapping_term, ht_quick_tap_ms, ht_prior_idle_ms) \
    /omit-if-no-ref/ ht_l_ ## name: ht_l_ ## name { \
        CREATE_HT_CORE(tap_bind, hold_bind, ht_flavor, ht_tapping_term, ht_quick_tap_ms, ht_prior_idle_ms) \
        hold-trigger-key-positions = <KEYS_R KEYS_THUMBS>; \
        hold-trigger-on-release; \
    };


#define CREATE_HT_LEFT_NO_TOR(name, hold_bind, tap_bind, ht_flavor, ht_tapping_term, ht_quick_tap_ms, ht_prior_idle_ms) \
    /omit-if-no-ref/ ht_l_ ## name: ht_l_ ## name { \
        CREATE_HT_CORE(tap_bind, hold_bind, ht_flavor, ht_tapping_term, ht_quick_tap_ms, ht_prior_idle_ms) \
        hold-trigger-key-positions = <KEYS_R KEYS_THUMBS>; \
    };



/ {
    behaviors {
        // trigger on release NOT enabled
        //CREATE_HT_LEFT_NO_TOR(nt, &kp, &kp, "balanced", HM_TAPPING_TERM, LAYER_QUICK_TAP_MS, HM_PRIOR_IDLE)
        //CREATE_HT_RIGHT_NO_TOR(nt, &kp, &kp, "balanced", HM_TAPPING_TERM, LAYER_QUICK_TAP_MS, HM_PRIOR_IDLE)

        // WITH trigger on release enabled
        CREATE_HT_LEFT(tr, &kp, &kp, "balanced", HM_TAPPING_TERM, LAYER_QUICK_TAP_MS, HM_PRIOR_IDLE)
        CREATE_HT_RIGHT(tr, &kp, &kp, "balanced", HM_TAPPING_TERM, LAYER_QUICK_TAP_MS, HM_PRIOR_IDLE)
    };
};
