/*
╭──────────────────────────────────────────────────────────╮
│ @Author:  TheDirkKnight     @Contact:  github.com/DiSc21 │
│ @License: MIT             @copyright: 2024 TheDirkKnight │
│ @Data:    2025/02/16                                     │
╰──────────────────────────────────────────────────────────╯
╭───────────────────────────────────────────────────────╮
│ @brief: ZMK combos — 15 horizontal-adjacent combos.  │
│                                                       │
│ @depends: shared_defs.dtsi for positions & timing.    │
│                                                       │
│ @details:                                             │
│ All combos use require-prior-idle-ms as roll guard    │
│ to prevent false triggers during fast typing.         │
│                                                       │
│ No mid-row combos (HRM zone).                        │
│ No cross-row combos (moved to symbols layer).        │
│ No 3-key or 4-key combos (too fragile).              │
╰───────────────────────────────────────────────────────╯
*/

#include "shared_defs.dtsi"

///
/// @brief combo creation macro with roll guard
///
/// @param name:          combo identifier
/// @param combo_binding: output binding
/// @param combo_keys:    key positions forming the combo
/// @param combo_timeout: time window for simultaneous press
/// @param combo_idle:    require-prior-idle-ms (roll guard)
///
#define COMBO(name, combo_binding, combo_keys, combo_timeout, combo_idle) \
    name { \
        timeout-ms = <combo_timeout>; \
        require-prior-idle-ms = <combo_idle>; \
        key-positions = <combo_keys>; \
        bindings = <combo_binding>; \
    };

#define COMBO_LAYER(name, combo_binding, combo_keys, combo_timeout, combo_idle, combo_layers) \
    name { \
        timeout-ms = <combo_timeout>; \
        require-prior-idle-ms = <combo_idle>; \
        key-positions = <combo_keys>; \
        bindings = <combo_binding>; \
        layers = <combo_layers>; \
    };

/ {
    combos {
        compatible = "zmk,combos";

        /*
         * LEFT HAND — Top Row
         * ╭─────┬─────┬─────┬─────┬─────╮
         * │  Q  │  W  │  E  │  R  │  T  │
         * │  :-ESC-:-INS-:-SCL-:-PGU-:  │
         */
        COMBO(combo_esc,       &kp ESC,       LT1 LT2, COMBO_TAP_TIME_FAST, COMBO_PRIOR_IDLE)
        COMBO(combo_insert,    &kp INSERT,    LT2 LT3, COMBO_TAP_TIME_FAST, COMBO_PRIOR_IDLE)
        COMBO(combo_caps_word, &caps_word,    LT3 LT4, COMBO_TAP_TIME_FAST, COMBO_PRIOR_IDLE)
        COMBO(combo_page_up,   &kp PG_UP,     LT4 LT5, COMBO_TAP_TIME_FAST, COMBO_PRIOR_IDLE)

        /*
         * RIGHT HAND — Top Row
         * ╭─────┬─────┬─────┬─────┬─────╮
         * │  Y  │  U  │  I  │  O  │  P  │
         * │     │  :- \ -:- * -:- ~ -:  │
         */
        COMBO(combo_bslh,      &kp BSLH,      RT1 RT2, COMBO_TAP_TIME_FAST, COMBO_PRIOR_IDLE)
        COMBO(combo_star,      &kp ASTERISK,  RT2 RT3, COMBO_TAP_TIME_FAST, COMBO_PRIOR_IDLE)
        COMBO(combo_tilde,     &kp TILDE,     RT3 RT4, COMBO_TAP_TIME_FAST, COMBO_PRIOR_IDLE)

        /*
         * MID ROW — NO COMBOS (HRM zone)
         */

        /*
         * LEFT HAND — Bottom Row
         * ╭─────┬─────┬─────┬─────┬─────╮
         * │  Z  │  X  │  C  │  V  │  B  │
         * │  :-HOM-:-SPC-:-END-:-PGD-:  │
         */
        COMBO(combo_home,      &kp HOME,      LB1 LB2, COMBO_TAP_TIME_FAST, COMBO_PRIOR_IDLE)
        COMBO(combo_space,     &kp SPACE,     LB2 LB3, COMBO_TAP_TIME_FAST, COMBO_PRIOR_IDLE)
        COMBO(combo_end,       &kp END,       LB3 LB4, COMBO_TAP_TIME_FAST, COMBO_PRIOR_IDLE)
        COMBO(combo_page_dn,   &kp PG_DN,     LB4 LB5, COMBO_TAP_TIME_FAST, COMBO_PRIOR_IDLE)

        /*
         * RIGHT HAND — Bottom Row
         * ╭─────┬─────┬─────┬─────┬─────╮
         * │  N  │  M  │  ,  │  .  │  /  │
         * │     │  :- ' -:- " -:- ` -:  │
         */
        COMBO(combo_quote,     &kp SQT,       RB1 RB2, COMBO_TAP_TIME_FAST, COMBO_PRIOR_IDLE)
        COMBO(combo_dblquote,  &kp DQT,       RB2 RB3, COMBO_TAP_TIME_FAST, COMBO_PRIOR_IDLE)
        COMBO(combo_grave,     &kp GRAVE,     RB3 RB4, COMBO_TAP_TIME_FAST, COMBO_PRIOR_IDLE)

        /*
         * CROSS-SIDE — BT/LED one-shot (default layer only)
         */
        COMBO_LAYER(combo_bt_led, &sl L_BT_LED, LT5 RT0, COMBO_TAP_TIME_FAST, COMBO_PRIOR_IDLE, L_DEF)
    };
};
